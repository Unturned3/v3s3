## Config.in
```kconfig
# Uncomment lines if needed
source "$BR2_EXTERNAL_V3S3_PATH/package/libcedarc/Config.in"
source "$BR2_EXTERNAL_V3S3_PATH/package/h264enc_demo/Config.in"

config BR2_EXTERNAL_ENABLE_INITRAMFS
	bool "Include pre-built initramfs image"
	default n
	help
		Enable the inclusion of an initramfs image in the rootfs. The initramfs
		image is built via 'make licheepi_zero_initramfs_defconfig'. For more
		information, see the Github repo.
```

## board/licheepi/uboot/uboot_defconfig
```kconfig
CONFIG_ARM=y
CONFIG_ARCH_SUNXI=y
CONFIG_DEFAULT_DEVICE_TREE="sun8i-v3s-licheepi-zero"
CONFIG_SPL=y
CONFIG_MACH_SUN8I_V3S=y
CONFIG_DRAM_CLK=360
# CONFIG_DISTRO_DEFAULTS is not set
CONFIG_ENV_VARS_UBOOT_CONFIG=y
# CONFIG_FIT is not set
CONFIG_BOOTDELAY=1
CONFIG_USE_BOOTCOMMAND=y
CONFIG_BOOTCOMMAND="run distro_bootcmd"
CONFIG_HUSH_PARSER=y
CONFIG_CMD_BOOTZ=y
CONFIG_CMD_PART=y
CONFIG_CMD_DHCP=y
CONFIG_CMD_MII=y
CONFIG_CMD_PING=y
CONFIG_CMD_PXE=y
CONFIG_CMD_SYSBOOT=y
CONFIG_CMD_EXT2=y
CONFIG_CMD_EXT4=y
CONFIG_CMD_FAT=y
CONFIG_CMD_FS_GENERIC=y
CONFIG_ISO_PARTITION=y
# CONFIG_NETDEVICES is not set
CONFIG_USB=y
CONFIG_SHA1=y
CONFIG_SHA256=y
CONFIG_MD5=y
```

## configs/licheepi_zero_defconfig
```kconfig
BR2_arm=y
BR2_cortex_a7=y
BR2_ARM_FPU_VFPV4=y
BR2_TOOLCHAIN_BUILDROOT_GLIBC=y
BR2_PACKAGE_HOST_LINUX_HEADERS_CUSTOM_5_4=y
BR2_TOOLCHAIN_BUILDROOT_CXX=y
BR2_TARGET_GENERIC_HOSTNAME="licheepi-zero"
BR2_TARGET_GENERIC_ISSUE="Welcome to Buildroot for the LicheePi Zero"
BR2_TARGET_GENERIC_GETTY_PORT="ttyS0"
BR2_TARGET_GENERIC_GETTY_BAUDRATE_115200=y
BR2_ROOTFS_POST_BUILD_SCRIPT="$(BR2_EXTERNAL_V3S3_PATH)/board/licheepi/get_initramfs.sh"
BR2_ROOTFS_POST_IMAGE_SCRIPT="support/scripts/genimage.sh"
BR2_ROOTFS_POST_SCRIPT_ARGS="-c $(BR2_EXTERNAL_V3S3_PATH)/board/licheepi/genimage.cfg"
BR2_LINUX_KERNEL=y
BR2_LINUX_KERNEL_CUSTOM_VERSION=y
BR2_LINUX_KERNEL_CUSTOM_VERSION_VALUE="5.4.35"
BR2_LINUX_KERNEL_PATCH="$(BR2_EXTERNAL_V3S3_PATH)/board/licheepi/linux/patch/cedar-VE.patch"
BR2_LINUX_KERNEL_USE_CUSTOM_CONFIG=y
BR2_LINUX_KERNEL_CUSTOM_CONFIG_FILE="$(BR2_EXTERNAL_V3S3_PATH)/board/licheepi/linux/v3s_linux_5.4.35_config"
BR2_LINUX_KERNEL_DTS_SUPPORT=y
BR2_LINUX_KERNEL_CUSTOM_DTS_PATH="$(BR2_EXTERNAL_V3S3_PATH)/board/licheepi/linux/sun8i-v3s.dtsi $(BR2_EXTERNAL_V3S3_PATH)/board/licheepi/linux/sun8i-v3s-licheepi-zero.dts $(BR2_EXTERNAL_V3S3_PATH)/board/licheepi/linux/sun8i-v3s-licheepi-zero-dock.dts"
BR2_LINUX_KERNEL_NEEDS_HOST_OPENSSL=y
BR2_PACKAGE_LINUX_FIRMWARE=y
BR2_PACKAGE_LINUX_FIRMWARE_RTL_87XX=y
BR2_PACKAGE_WPA_SUPPLICANT=y
BR2_PACKAGE_WPA_SUPPLICANT_AUTOSCAN=y
BR2_TARGET_ROOTFS_EXT2=y
BR2_TARGET_ROOTFS_EXT2_4=y
BR2_TARGET_UBOOT=y
BR2_TARGET_UBOOT_BUILD_SYSTEM_KCONFIG=y
BR2_TARGET_UBOOT_CUSTOM_VERSION=y
BR2_TARGET_UBOOT_CUSTOM_VERSION_VALUE="2022.01"
BR2_TARGET_UBOOT_USE_CUSTOM_CONFIG=y
BR2_TARGET_UBOOT_CUSTOM_CONFIG_FILE="$(BR2_EXTERNAL_V3S3_PATH)/board/licheepi/uboot/uboot_config"
BR2_TARGET_UBOOT_NEEDS_DTC=y
BR2_TARGET_UBOOT_NEEDS_PYLIBFDT=y
BR2_TARGET_UBOOT_FORMAT_CUSTOM=y
BR2_TARGET_UBOOT_FORMAT_CUSTOM_NAME="u-boot-sunxi-with-spl.bin"
BR2_PACKAGE_HOST_DOSFSTOOLS=y
BR2_PACKAGE_HOST_GENIMAGE=y
BR2_PACKAGE_HOST_MTOOLS=y
BR2_PACKAGE_HOST_UBOOT_TOOLS=y
BR2_PACKAGE_HOST_UBOOT_TOOLS_BOOT_SCRIPT=y
BR2_PACKAGE_HOST_UBOOT_TOOLS_BOOT_SCRIPT_SOURCE="$(BR2_EXTERNAL_V3S3_PATH)/board/licheepi/boot.cmd"
```

## configs/licheepi_zero_initramfs_defconfig
```kconfig
BR2_arm=y
BR2_cortex_a7=y
BR2_ARM_FPU_VFPV4=y
BR2_TOOLCHAIN_BUILDROOT_MUSL=y
BR2_KERNEL_HEADERS_VERSION=y
BR2_DEFAULT_KERNEL_VERSION="5.4.35"
BR2_PACKAGE_HOST_LINUX_HEADERS_CUSTOM_5_4=y
BR2_TOOLCHAIN_BUILDROOT_CXX=y
BR2_ROOTFS_SKELETON_CUSTOM=y
BR2_ROOTFS_SKELETON_CUSTOM_PATH="$(BR2_EXTERNAL_V3S3_PATH)/board/licheepi/initramfs/initramfs-skel"
BR2_INIT_NONE=y
BR2_ROOTFS_DEVICE_TABLE="$(BR2_EXTERNAL_V3S3_PATH)/board/licheepi/initramfs/initramfs_device_table.txt"
BR2_ROOTFS_MERGED_USR=y
BR2_SYSTEM_DEFAULT_PATH="/bin:/sbin"
BR2_ROOTFS_OVERLAY="$(BR2_EXTERNAL_V3S3_PATH)/board/licheepi/initramfs/overlay"
BR2_ROOTFS_POST_IMAGE_SCRIPT="$(BR2_EXTERNAL_V3S3_PATH)/board/licheepi/initramfs/copy_initramfs.sh"
BR2_ROOTFS_POST_SCRIPT_ARGS="$(BR2_EXTERNAL_V3S3_PATH)"
BR2_PACKAGE_BUSYBOX_CONFIG="$(BR2_EXTERNAL_V3S3_PATH)/board/licheepi/initramfs/initramfs_busybox_defconfig"
BR2_PACKAGE_LIBUBOOTENV=y
BR2_PACKAGE_DROPBEAR=y
BR2_PACKAGE_IFUPDOWN_SCRIPTS=y
BR2_PACKAGE_RSYNC=y
BR2_PACKAGE_URANDOM_SCRIPTS=y
BR2_TARGET_ROOTFS_CPIO=y
BR2_TARGET_ROOTFS_CPIO_GZIP=y
BR2_TARGET_ROOTFS_CPIO_UIMAGE=y
# BR2_TARGET_ROOTFS_TAR is not set
BR2_PACKAGE_HOST_DOSFSTOOLS=y
BR2_PACKAGE_HOST_DTC=y
BR2_PACKAGE_HOST_E2FSPROGS=y
BR2_PACKAGE_HOST_GENIMAGE=y
BR2_PACKAGE_HOST_KMOD=y
BR2_PACKAGE_HOST_MTOOLS=y
BR2_PACKAGE_HOST_UBOOT_TOOLS_BOOT_SCRIPT=y
BR2_PACKAGE_HOST_UBOOT_TOOLS_BOOT_SCRIPT_SOURCE="$(BR2_EXTERNAL_V3S3_PATH)/board/licheepi/boot.cmd"
```

## configs/tau_defconfig
```kconfig
BR2_arm=y
BR2_cortex_a7=y
BR2_ARM_FPU_VFPV4=y
BR2_TOOLCHAIN_BUILDROOT_GLIBC=y
BR2_TOOLCHAIN_BUILDROOT_CXX=y
BR2_TARGET_GENERIC_HOSTNAME="licheepi-zero"
BR2_TARGET_GENERIC_ISSUE="Welcome to Buildroot for the LicheePi Zero"
BR2_TARGET_GENERIC_GETTY_PORT="ttyS0"
BR2_TARGET_GENERIC_GETTY_BAUDRATE_115200=y
BR2_ROOTFS_OVERLAY="$(BR2_EXTERNAL_V3S3_PATH)/board/licheepi/overlay"
BR2_ROOTFS_POST_BUILD_SCRIPT="$(BR2_EXTERNAL_V3S3_PATH)/board/licheepi/post-build.sh"
BR2_ROOTFS_POST_IMAGE_SCRIPT="support/scripts/genimage.sh"
BR2_ROOTFS_POST_SCRIPT_ARGS="-c $(BR2_EXTERNAL_V3S3_PATH)/board/licheepi/genimage.cfg"
BR2_LINUX_KERNEL=y
BR2_LINUX_KERNEL_CUSTOM_VERSION=y
BR2_LINUX_KERNEL_CUSTOM_VERSION_VALUE="5.19.3"
BR2_LINUX_KERNEL_PATCH="$(BR2_EXTERNAL_V3S3_PATH)/board/licheepi/linux/patch"
BR2_LINUX_KERNEL_USE_CUSTOM_CONFIG=y
BR2_LINUX_KERNEL_CUSTOM_CONFIG_FILE="$(BR2_EXTERNAL_V3S3_PATH)/board/licheepi/linux/linux_5.19.3_config"
BR2_LINUX_KERNEL_DTS_SUPPORT=y
BR2_LINUX_KERNEL_CUSTOM_DTS_PATH="$(BR2_EXTERNAL_V3S3_PATH)/board/licheepi/linux/sun8i-v3s.dtsi $(BR2_EXTERNAL_V3S3_PATH)/board/licheepi/linux/sun8i-v3s-licheepi-zero.dts $(BR2_EXTERNAL_V3S3_PATH)/board/licheepi/linux/sun8i-v3s-licheepi-zero-dock.dts"
BR2_LINUX_KERNEL_NEEDS_HOST_OPENSSL=y
BR2_PACKAGE_BUSYBOX_CONFIG="$(BR2_EXTERNAL_V3S3_PATH)/board/licheepi/busybox/busybox_config"
BR2_PACKAGE_FFMPEG=y
BR2_PACKAGE_FFMPEG_GPL=y
BR2_PACKAGE_FFMPEG_NONFREE=y
BR2_PACKAGE_FFMPEG_AVRESAMPLE=y
BR2_PACKAGE_FFMPEG_POSTPROC=y
BR2_PACKAGE_FFMPEG_SWSCALE=y
BR2_PACKAGE_E2FSPROGS=y
BR2_PACKAGE_E2FSPROGS_RESIZE2FS=y
BR2_PACKAGE_FSWEBCAM=y
BR2_PACKAGE_LINUX_FIRMWARE=y
BR2_PACKAGE_LIBUBOOTENV=y
BR2_PACKAGE_CRYPTODEV=y
BR2_PACKAGE_OPENSSL=y
BR2_PACKAGE_LIBOPENSSL_BIN=y
BR2_PACKAGE_LIBOPENSSL_ENGINES=y
BR2_PACKAGE_LIBV4L_UTILS=y
BR2_PACKAGE_LIBCURL=y
BR2_PACKAGE_LIBCURL_CURL=y
BR2_PACKAGE_DROPBEAR=y
BR2_PACKAGE_MJPG_STREAMER=y
BR2_PACKAGE_WPA_SUPPLICANT=y
BR2_PACKAGE_WPA_SUPPLICANT_AUTOSCAN=y
BR2_TARGET_ROOTFS_EXT2=y
BR2_TARGET_ROOTFS_EXT2_4=y
BR2_TARGET_ROOTFS_EXT2_SIZE="100M"
BR2_TARGET_UBOOT=y
BR2_TARGET_UBOOT_BUILD_SYSTEM_KCONFIG=y
BR2_TARGET_UBOOT_CUSTOM_VERSION=y
BR2_TARGET_UBOOT_CUSTOM_VERSION_VALUE="2022.01"
BR2_TARGET_UBOOT_USE_CUSTOM_CONFIG=y
BR2_TARGET_UBOOT_CUSTOM_CONFIG_FILE="$(BR2_EXTERNAL_V3S3_PATH)/board/licheepi/uboot/uboot_config"
BR2_TARGET_UBOOT_NEEDS_DTC=y
BR2_TARGET_UBOOT_NEEDS_PYLIBFDT=y
BR2_TARGET_UBOOT_FORMAT_CUSTOM=y
BR2_TARGET_UBOOT_FORMAT_CUSTOM_NAME="u-boot-sunxi-with-spl.bin"
BR2_PACKAGE_HOST_DOSFSTOOLS=y
BR2_PACKAGE_HOST_GENIMAGE=y
BR2_PACKAGE_HOST_MTOOLS=y
BR2_PACKAGE_HOST_UBOOT_TOOLS=y
BR2_PACKAGE_HOST_UBOOT_TOOLS_ENVIMAGE=y
BR2_PACKAGE_HOST_UBOOT_TOOLS_ENVIMAGE_SOURCE="$(BR2_EXTERNAL_V3S3_PATH)/board/licheepi/uboot/uboot-env.txt"
BR2_PACKAGE_HOST_UBOOT_TOOLS_ENVIMAGE_SIZE="0x1000"
BR2_PACKAGE_HOST_UBOOT_TOOLS_BOOT_SCRIPT=y
BR2_PACKAGE_HOST_UBOOT_TOOLS_BOOT_SCRIPT_SOURCE="$(BR2_EXTERNAL_V3S3_PATH)/board/licheepi/uboot/boot.cmd"
BR2_PACKAGE_LIBCEDARC_DECODER=y
# BR2_PACKAGE_LIBCEDARC_DECODER_AVS is not set
# BR2_PACKAGE_LIBCEDARC_DECODER_H265 is not set
# BR2_PACKAGE_LIBCEDARC_DECODER_MPEG2 is not set
# BR2_PACKAGE_LIBCEDARC_DECODER_MPEG4 is not set
# BR2_PACKAGE_LIBCEDARC_DECODER_VP8 is not set
# BR2_PACKAGE_LIBCEDARC_DECODER_VP9 is not set
# BR2_PACKAGE_LIBCEDARC_DECODER_WMV3 is not set
BR2_PACKAGE_LIBCEDARC_OPENMAX=y
BR2_PACKAGE_H264ENC_DEMO=y
```

## package/h264enc_demo/Config.in
```kconfig
config BR2_PACKAGE_H264ENC_DEMO
	bool "CedarVE H.264 encoding demo"
	default n
	select BR2_PACKAGE_LIBV4L
	select BR2_PACKAGE_LIBCEDARC
	select BR2_PACKAGE_LIBCEDARC_ENCODER
	help
		Demo program for encoding DVP camera stream to H.264
```
